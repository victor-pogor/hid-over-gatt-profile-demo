/**
 * @cliArgs --board "/ti/boards/LP_CC2652R7" --rtos "tirtos7" --product "simplelink_cc13xx_cc26xx_sdk@7.41.00.17"
 * @versions {"tool":"1.18.1+3343"}
 */

/**
 * Import the modules used in this configuration.
 */
const ble         = scripting.addModule("/ti/ble5stack/ble");
const GPIO        = scripting.addModule("/ti/drivers/GPIO");
const GPIO1       = GPIO.addInstance();
const GPIO2       = GPIO.addInstance();
const Power       = scripting.addModule("/ti/drivers/Power");
const Settings    = scripting.addModule("/ti/posix/tirtos/Settings");
const BIOS        = scripting.addModule("/ti/sysbios/BIOS");
const Event       = scripting.addModule("/ti/sysbios/knl/Event");
const Idle        = scripting.addModule("/ti/sysbios/knl/Idle", {}, false);
const Idle2       = Idle.addInstance();
const Mailbox     = scripting.addModule("/ti/sysbios/knl/Mailbox");
const Error       = scripting.addModule("/ti/sysbios/runtime/Error");
const SysCallback = scripting.addModule("/ti/sysbios/runtime/SysCallback");
const Timestamp   = scripting.addModule("/ti/sysbios/runtime/Timestamp");

/**
 * Write custom configuration values to the imported modules.
 */
ble.addressMode                        = "ADDRMODE_RANDOM";
ble.maxConnNum                         = 1;
ble.randomAddress                      = "c0:cd:c4:c3:c2:c1";
ble.maxPDUNum                          = 255;
ble.L2CAPCOC                           = true;
ble.deviceName                         = "Victor's HID Mouse";
ble.keyDistList                        = ["GAPBOND_KEYDIST_MIDKEY","GAPBOND_KEYDIST_MSIGN","GAPBOND_KEYDIST_SSIGN"];
ble.tbmActiveItemsOnly                 = false;
ble.numOfAdvSets                       = 3;
ble.radioConfig.codeExportConfig.$name = "ti_devices_radioconfig_code_export_param0";
ble.connUpdateParamsPeripheral.$name   = "ti_ble5stack_general_ble_conn_update_params0";
ble.advSet1.$name                      = "ti_ble5stack_broadcaster_advertisement_set0";
ble.advSet1.advParam1.$name            = "ti_ble5stack_broadcaster_advertisement_params0";
ble.advSet1.advData1.$name             = "ti_ble5stack_broadcaster_advertisement_data0";
ble.advSet1.scanRes1.$name             = "ti_ble5stack_broadcaster_advertisement_data1";
ble.advSet2.$name                      = "ti_ble5stack_broadcaster_advertisement_set1";
ble.advSet2.advParam2.$name            = "ti_ble5stack_broadcaster_advertisement_params1";
ble.advSet2.advData2.$name             = "ti_ble5stack_broadcaster_advertisement_data2";
ble.advSet2.scanRes2.$name             = "ti_ble5stack_broadcaster_advertisement_data3";
ble.advSet3.$name                      = "ti_ble5stack_broadcaster_advertisement_set2";
ble.advSet3.advParam3.$name            = "ti_ble5stack_broadcaster_advertisement_params2";
ble.advSet3.advData3.$name             = "ti_ble5stack_broadcaster_advertisement_data4";
ble.advSet3.scanRes3.$name             = "ti_ble5stack_broadcaster_advertisement_data5";
scripting.suppress("The example app code handles 2 advertisement sets\\. Please make sure to update the example app code according to the configured number of sets\\.", ble, "numOfAdvSets");

GPIO1.$hardware = system.deviceData.board.components.LED_RED;
GPIO1.$name     = "CONFIG_GPIO_LED_0";

GPIO2.$name     = "CONFIG_GPIO_LED_1";
GPIO2.$hardware = system.deviceData.board.components.LED_GREEN;

const CCFG              = scripting.addModule("/ti/devices/CCFG", {}, false);
CCFG.ccfgTemplate.$name = "ti_devices_CCFG_CCFGCC26XXTemplate0";

BIOS.assertsEnabled = false;
BIOS.heapBaseAddr   = "__primary_heap_start__";
BIOS.heapEndAddr    = "__primary_heap_end__";

const Clock      = scripting.addModule("/ti/sysbios/knl/Clock", {}, false);
Clock.tickPeriod = 10;

const Timer = scripting.addModule("/ti/sysbios/family/arm/cc26xx/Timer", {}, false);

Idle2.$name   = "powerIdle";
Idle2.idleFxn = "Power_idleFunc";

const Semaphore            = scripting.addModule("/ti/sysbios/knl/Semaphore", {}, false);
Semaphore.supportsPriority = false;

const Swi         = scripting.addModule("/ti/sysbios/knl/Swi", {}, false);
Swi.numPriorities = 6;

const Task             = scripting.addModule("/ti/sysbios/knl/Task", {}, false);
Task.checkStackFlag    = false;
Task.defaultStackSize  = 512;
Task.idleTaskStackSize = 512;
Task.numPriorities     = 6;

Error.policy       = "Error_SPIN";
Error.printDetails = false;

const System           = scripting.addModule("/ti/sysbios/runtime/System", {}, false);
System.abortFxn        = "System_abortSpin";
System.exitFxn         = "System_exitSpin";
System.extendedFormats = "%f";
System.supportModule   = "SysCallback";

/**
 * Pinmux solution for unlocked pins/peripherals. This ensures that minor changes to the automatic solver in a future
 * version of the tool will not impact the pinmux you originally saw.  These lines can be completely deleted in order to
 * re-solve from scratch.
 */
GPIO1.gpioPin.$suggestSolution = "boosterpack.39";
GPIO2.gpioPin.$suggestSolution = "boosterpack.40";
Timer.rtc.$suggestSolution     = "RTC0";
